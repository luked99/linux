## drivers/char/broadcom/Kconfig
```kconfig
#
# Broadcom char driver config
#

menuconfig BRCM_CHAR_DRIVERS
	bool "Broadcom Char Drivers"
	help
	  Broadcom's char drivers

config BCM_VC_CMA
	bool "Videocore CMA"
	depends on CMA && BRCM_CHAR_DRIVERS
	default n
        help
          Helper for videocore CMA access.

config BCM_VC_RPMSG
	tristate "VideoCore rpmsg support"
	depends on BRCM_CHAR_DRIVERS
	select RPMSG
	default n
	help
	  This enables VideoCore rpmsg support, which lets kernel
	  drivers connect to services running on the VideoCore
	  remote processor. This should be enabled on any platform
	  that uses the VideoCore VPUs.

config BCM_VC_RPMSG_SERVICES
	tristate "VideoCore rpmsg services"
	depends on BRCM_CHAR_DRIVERS
	default n
	help
	  This driver exposes VideoCore services to userspace as
	  char devices, including support for shared-memory buffers.
	  This should be enabled on any platform that uses the
	  VideoCore VPUs.
```
